;******************************************************************************
;* TMS320C3x/4x ANSI C Code Generator                            Version 5.11 *
;* Date/Time created: Fri Nov  1 11:36:30 2002                                *
;******************************************************************************
	.regalias	; enable floating point register aliases
fp	.set	ar3
FP	.set	ar3
;******************************************************************************
;* GLOBAL FILE PARAMETERS                                                     *
;*                                                                            *
;*   Optimization       : Always Choose Smaller Code Size                     *
;*   Memory             : Small Memory Model                                  *
;*   Float-to-Int       : Normal Conversions (round toward zero)              *
;*   Multiply           : in Hardware (24 bits max)                           *
;*   Memory Info        : Unmapped Memory Exists                              *
;*   Repeat Loops       : Use RPTS and/or RPTB                                *
;*   Calls              : Normal Library ASM calls                            *
;*   Debug Info         : Optimized TI Debug Information                      *
;******************************************************************************
;	C:\LANG\TMS320C3X\BIN\AC30.EXE simple.c C:\WINDOWS\TEMP\simple.if 
	.file	"simple.c"
	.file	"ALL_DEF.h"
	.sym	_WORD,0,14,13,32
	.sym	_BYTE,0,12,13,32
	.file	"debug3x.h"
	.sect	 ".text"

	.global	_c_int06
	.sym	_c_int06,_c_int06,32,2,0
	.func	26
;******************************************************************************
;* FUNCTION NAME: _c_int06                                                    *
;*                                                                            *
;*   Architecture       : TMS320C30                                           *
;*   Calling Convention : Stack Parameter Convention                          *
;*   Function Uses Regs : r0,ar0,st                                           *
;*   Regs Saved         : f0,r0,ar0,pc                                        *
;*   Stack Frame        : Full (w/ debug)                                     *
;*   Total Frame Size   : 2 Call + 0 Parm + 2 Auto + 3 SOE = 7 words          *
;******************************************************************************
_c_int06:
	.sym	_nRXData,1,15,1,32
	.sym	_nTXData,2,15,1,32
	.line	1
;----------------------------------------------------------------------
;  26 | void c_int06()                                                         
;  28 | unsigned long nRXData;                                                 
;  29 | unsigned long nTXData;                                                 
;----------------------------------------------------------------------
        push      st
        push      fp
        ldiu      sp,fp
        addi      2,sp
        push      r0
        pushf     f0
        push      ar0
	.line	6
;----------------------------------------------------------------------
;  31 | nRXData = *(unsigned long *)0x80804c;                                  
;  33 | switch(nRXData >> 24)                                                  
;  35 |         case 0x00:                                                     
;----------------------------------------------------------------------
        bud       L12
        ldiu      @CL1,ar0
        ldiu      *ar0,r0
        sti       r0,*+fp(1)
;*      Branch Occurs to L12 
L2:        
	.line	11
;----------------------------------------------------------------------
;  36 | nTXData = *(unsigned long *)nRXData;                                   
;----------------------------------------------------------------------
        ldiu      *+fp(1),ar0
        ldiu      *ar0,r0
        sti       r0,*+fp(2)
	.line	12
;----------------------------------------------------------------------
;  37 | break;                                                                 
;  39 | case 0x1D:                                                             
;----------------------------------------------------------------------
        bu        L20
;*      Branch Occurs to L20 
L3:        
	.line	15
;----------------------------------------------------------------------
;  40 | nTXData = DEBUG_3X_ID_VALUE;                                           
;----------------------------------------------------------------------
        ldiu      @CL2,r0
        sti       r0,*+fp(2)
	.line	16
;----------------------------------------------------------------------
;  41 | break;                                                                 
;  43 | case 0x88:                                                             
;----------------------------------------------------------------------
        bu        L20
;*      Branch Occurs to L20 
L4:        
	.line	19
;----------------------------------------------------------------------
;  44 | nTXData = 0x12345678;                                                  
;----------------------------------------------------------------------
        ldiu      @CL2,r0
        sti       r0,*+fp(2)
	.line	20
;----------------------------------------------------------------------
;  45 | break;                                                                 
;  47 | case 0xAD:                                                             
;----------------------------------------------------------------------
        bu        L20
;*      Branch Occurs to L20 
L5:        
	.line	23
;----------------------------------------------------------------------
;  48 | _glDebugAddr = nRXData & 0xffffff;                                     
;----------------------------------------------------------------------
        ldiu      @CL3,r0
        and       *+fp(1),r0
        sti       r0,@__glDebugAddr+0
	.line	24
;----------------------------------------------------------------------
;  49 | nTXData = _glDebugAddr;                                                
;----------------------------------------------------------------------
        sti       r0,*+fp(2)
	.line	25
;----------------------------------------------------------------------
;  50 | break;                                                                 
;  52 | case 0xD1:                                                             
;----------------------------------------------------------------------
        bu        L20
;*      Branch Occurs to L20 
L6:        
	.line	28
;----------------------------------------------------------------------
;  53 | _glDebugData = (nRXData << 16) & 0xffff0000;                           
;----------------------------------------------------------------------
        ldiu      *+fp(1),r0
        ash       16,r0
        andn      65535,r0
        sti       r0,@__glDebugData+0
	.line	29
;----------------------------------------------------------------------
;  54 | nTXData = _glDebugData;                                                
;----------------------------------------------------------------------
        sti       r0,*+fp(2)
	.line	30
;----------------------------------------------------------------------
;  55 | break;                                                                 
;  57 | case 0xD0:                                                             
;----------------------------------------------------------------------
        bu        L20
;*      Branch Occurs to L20 
L7:        
	.line	33
;----------------------------------------------------------------------
;  58 | _glDebugData |= (nRXData & 0xffff);                                    
;----------------------------------------------------------------------
        ldiu      *+fp(1),r0
        and       65535,r0
        or        @__glDebugData+0,r0
        sti       r0,@__glDebugData+0
	.line	34
;----------------------------------------------------------------------
;  59 | nTXData = _glDebugData;                                                
;----------------------------------------------------------------------
        sti       r0,*+fp(2)
	.line	35
;----------------------------------------------------------------------
;  60 | break;                                                                 
;  62 | case 0x33:                                                             
;----------------------------------------------------------------------
        bu        L20
;*      Branch Occurs to L20 
	.line	38
;----------------------------------------------------------------------
;  63 | *(unsigned long *)_glDebugAddr = _glDebugData;                         
;----------------------------------------------------------------------
L9:        
        sti       r0,*ar0
	.line	39
;----------------------------------------------------------------------
;  64 | break;                                                                 
;  66 | default:                                                               
;----------------------------------------------------------------------
        bu        L20
;*      Branch Occurs to L20 
	.line	42
;----------------------------------------------------------------------
;  67 | nTXData = 0xffffffff;                                                  
;----------------------------------------------------------------------
	.line	43
;----------------------------------------------------------------------
;  68 | break;                                                                 
;----------------------------------------------------------------------
L12:        
	.line	8
        ldiu      *+fp(1),r0
        lsh       -24,r0
        beq       L2
;*      Branch Occurs to L2 
        cmpi      29,r0
        beq       L3
;*      Branch Occurs to L3 
        cmpi      51,r0
        beqd      L9
	nop
        ldieq     @__glDebugAddr+0,ar0
        ldieq     @__glDebugData+0,r0
;*      Branch Occurs to L9 
        cmpi      136,r0
        beq       L4
;*      Branch Occurs to L4 
        cmpi      173,r0
        beq       L5
;*      Branch Occurs to L5 
        cmpi      208,r0
        beq       L7
;*      Branch Occurs to L7 
        cmpi      209,r0
        beq       L6
;*      Branch Occurs to L6 
        ldiu      @CL4,r0
        sti       r0,*+fp(2)
L20:        
	.line	46
;----------------------------------------------------------------------
;  71 | *(unsigned long *)0x808048 = nTXData;                                  
;----------------------------------------------------------------------
        ldiu      @CL5,ar0
        ldiu      *+fp(2),r0
        sti       r0,*ar0
	.line	47
        pop       ar0
        popf      f0
        pop       r0
        subi      2,sp
        pop       fp
        pop       st
        reti
                                        	; Return From Interrupt
	.endfunc	72,000000101h,2


	.sect	 ".text"

	.global	_Debug3xInit
	.sym	_Debug3xInit,_Debug3xInit,32,2,0
	.func	93
;******************************************************************************
;* FUNCTION NAME: _Debug3xInit                                                *
;*                                                                            *
;*   Architecture       : TMS320C30                                           *
;*   Calling Convention : Stack Parameter Convention                          *
;*   Function Uses Regs : r0,ar0,st                                           *
;*   Regs Saved         :                                                     *
;*   Stack Frame        : Full (w/ debug)                                     *
;*   Total Frame Size   : 2 Call + 1 Parm + 1 Auto + 0 SOE = 4 words          *
;******************************************************************************
_Debug3xInit:
	.sym	_nKind,-2,12,9,32
	.sym	_nTemp,1,4,1,32
	.line	1
;----------------------------------------------------------------------
;  93 | void Debug3xInit(unsigned char nKind)                                  
;----------------------------------------------------------------------
        push      fp
        ldiu      sp,fp
        addi      1,sp
	.line	2
;----------------------------------------------------------------------
;  95 | int nTemp;                                                             
;----------------------------------------------------------------------
	.line	5
;----------------------------------------------------------------------
;  97 | *(unsigned long *)0x808042 = 0x111;                                    
;----------------------------------------------------------------------
        ldiu      @CL6,ar0
        ldiu      273,r0
        sti       r0,*ar0
	.line	6
;----------------------------------------------------------------------
;  98 | *(unsigned long *)0x808040 = 0x0e3c0000;                               
;----------------------------------------------------------------------
        ldiu      @CL7,ar0
        ldiu      @CL8,r0
        sti       r0,*ar0
	.line	7
;----------------------------------------------------------------------
;  99 | nTemp = *(unsigned long *)0x80804c;                                    
; 101 | switch(nKind)                                                          
; 103 | default:                                                               
; 107 | case TMS320C31:                                                        
; 108 | case TMS320C33:                                                        
;----------------------------------------------------------------------
        bud       L28
        ldiu      @CL1,ar0
        ldiu      *ar0,r0
        sti       r0,*+fp(1)
;*      Branch Occurs to L28 
L24:        
	.line	17
;----------------------------------------------------------------------
; 109 | (*(unsigned long *)0x809fc6) = 0x60000000 | (int)c_int06;              
;----------------------------------------------------------------------
        ldiu      @CL10,r0
        ldiu      @CL9,ar0
        or        @CL11,r0
        sti       r0,*ar0
	.line	18
;----------------------------------------------------------------------
; 110 | break;                                                                 
; 115 | case TMS320C32:                                                        
;----------------------------------------------------------------------
        bu        L32
;*      Branch Occurs to L32 
	.line	24
;----------------------------------------------------------------------
; 116 | (*(unsigned long *)0x87fe06) = 0x60000000 | (int)c_int06;              
; 118 | // 인터럽트 벡터를 다시 구성한다.                                      
;----------------------------------------------------------------------
L26:        
        or        @CL11,r0
        sti       r0,*ar0
	.line	27
;----------------------------------------------------------------------
; 119 | asm("   LDI     87feh, IF ");                                          
;----------------------------------------------------------------------
   LDI     87feh, IF 
	.line	28
;----------------------------------------------------------------------
; 120 | asm("   LSH     10h, IF ");     // 0x87fe0000 <---------------         
;----------------------------------------------------------------------
   LSH     10h, IF 
	.line	29
;----------------------------------------------------------------------
; 121 | break;                                                                 
; 124 | // 인터럽트를 활성화 시킨다.                                           
;----------------------------------------------------------------------
        bu        L32
;*      Branch Occurs to L32 
L28:        
	.line	9
        ldiu      *-fp(2),r0
        cmpi      31,r0
        beq       L24
;*      Branch Occurs to L24 
        cmpi      32,r0
        beqd      L26
	nop
        ldieq     @CL10,r0
        ldieq     @CL12,ar0
;*      Branch Occurs to L26 
        cmpi      33,r0
        beq       L24
;*      Branch Occurs to L24 
        bu        L24
;*      Branch Occurs to L24 
L32:        
	.line	33
;----------------------------------------------------------------------
; 125 | asm("   OR      0020h,IE");                                            
;----------------------------------------------------------------------
	OR	0020h,IE
	.line	34
        ldiu      *-fp(1),ar0
        ldiu      *fp,fp
        subi      3,sp
        bu        ar0
;*      Branch Occurs to ar0 
	.endfunc	126,000000000h,1


	.file	"simple.c"

	.sect	".cinit"
	.field  	1,32
	.field  	_glDebugCnt+0,32
	.field  	0,32		; _glDebugCnt @ 0

	.sect	".text"

	.global	_glDebugCnt
	.bss	_glDebugCnt,1
	.sym	_glDebugCnt,_glDebugCnt,14,2,32

	.sect	".cinit"
	.field  	1,32
	.field  	_glFloatCnt+0,32
	.word   	080000000H ; float   0.000000000000000e+00
                                   ; _glFloatCnt @ 0

	.sect	".text"

	.global	_glFloatCnt
	.bss	_glFloatCnt,1
	.sym	_glFloatCnt,_glFloatCnt,6,2,32
	.sect	 ".text"

	.global	_main
	.sym	_main,_main,32,2,0
	.func	27
;******************************************************************************
;* FUNCTION NAME: _main                                                       *
;*                                                                            *
;*   Architecture       : TMS320C30                                           *
;*   Calling Convention : Stack Parameter Convention                          *
;*   Function Uses Regs : r0,fp,sp,st                                         *
;*   Regs Saved         :                                                     *
;*   Stack Frame        : Full (w/ debug)                                     *
;*   Total Frame Size   : 2 Call + 0 Parm + 1 Auto + 0 SOE = 3 words          *
;******************************************************************************
_main:
	.sym	_i,1,12,1,32
	.line	1
;----------------------------------------------------------------------
;  27 | void main(void)                                                        
;  29 | BYTE i;                                                                
;----------------------------------------------------------------------
        push      fp
        ldiu      sp,fp
        addi      1,sp
	.line	5
;----------------------------------------------------------------------
;  31 | DINT; // 전역 인어텁트 불가능                                          
;----------------------------------------------------------------------
 AND       0DFFFh, ST 
	.line	6
;----------------------------------------------------------------------
;  32 | DSP_INIT() ;                                                           
;----------------------------------------------------------------------
        call      _DSP_INIT
                                        ; Call Occurs
	.line	7
;----------------------------------------------------------------------
;  33 | Debug3xInit(TMS320C32);                                                
;----------------------------------------------------------------------
        ldiu      32,r0
        push      r0
        call      _Debug3xInit
                                        ; Call Occurs
        subi      1,sp
	.line	8
;----------------------------------------------------------------------
;  34 | EINT; // 전역 인어텁트 가능                                            
;  36 | //for(i=0;i<256;i++) glTest[i] = (float)i;                             
;  38 | while(1)                                                               
;----------------------------------------------------------------------
 OR        02000h, ST 
L36:        
	.line	14
;----------------------------------------------------------------------
;  40 | glDebugCnt++;                                                          
;----------------------------------------------------------------------
        ldiu      1,r0
        addi      @_glDebugCnt+0,r0     ; Unsigned
        sti       r0,@_glDebugCnt+0
	.line	15
;----------------------------------------------------------------------
;  41 | for(i=0;i<0xffff;i++);                                                 
;----------------------------------------------------------------------
        ldiu      0,r0
        sti       r0,*+fp(1)
        cmpi      @CL13,r0
        bhs       L36
;*      Branch Occurs to L36 
L37:        
        ldiu      1,r0
        addi      *+fp(1),r0            ; Unsigned
        sti       r0,*+fp(1)
        cmpi      @CL13,r0
        blo       L37
;*      Branch Occurs to L37 
	.line	16
        bu        L36
;*      Branch Occurs to L36 
	.line	18
	.endfunc	44,000000000h,1


	.sect	 ".text"

	.global	_DSP_INIT
	.sym	_DSP_INIT,_DSP_INIT,32,2,0
	.func	49
;******************************************************************************
;* FUNCTION NAME: _DSP_INIT                                                   *
;*                                                                            *
;*   Architecture       : TMS320C30                                           *
;*   Calling Convention : Stack Parameter Convention                          *
;*   Function Uses Regs : r0,ar0                                              *
;*   Regs Saved         :                                                     *
;*   Stack Frame        : Full (w/ debug)                                     *
;*   Total Frame Size   : 2 Call + 0 Parm + 1 Auto + 0 SOE = 3 words          *
;******************************************************************************
_DSP_INIT:
	.sym	_temp,1,4,1,32
	.line	1
;----------------------------------------------------------------------
;  49 | void DSP_INIT(void)                                                    
;  51 | int temp;                                                              
;----------------------------------------------------------------------
        push      fp
        ldiu      sp,fp
        addi      1,sp
	.line	6
;----------------------------------------------------------------------
;  54 | STRB0_CTRL = 0x000f0468;        /* Bank=1M, Wait=1, SWW=3 wait by softw
;     | are */                                                                 
;----------------------------------------------------------------------
        ldiu      @CL14,ar0
        ldiu      @CL15,r0
        sti       r0,*ar0
	.line	7
;----------------------------------------------------------------------
;  55 | STRB1_CTRL = 0x000f0408;        /* Bank=1M, Wait=0, SWW=0 wait by softw
;     | are */                                                                 
;----------------------------------------------------------------------
        ldiu      @CL16,ar0
        ldiu      @CL17,r0
        sti       r0,*ar0
	.line	9
;----------------------------------------------------------------------
;  57 | IOSTRB_CTRL = 0x00000068;       /* Wait=2, SWW=11 wait by software */  
;----------------------------------------------------------------------
        ldiu      @CL18,ar0
        ldiu      104,r0
        sti       r0,*ar0
	.line	12
;----------------------------------------------------------------------
;  60 | TMR0_CTRL = 0x02C2 ;            /* General Out port : TCLK0 */         
;----------------------------------------------------------------------
        ldiu      @CL19,ar0
        ldiu      706,r0
        sti       r0,*ar0
	.line	13
;----------------------------------------------------------------------
;  61 | TMR0_PERD = 4000;               /* 30.72 MHz/4 /(32*60) = 4000 */      
;----------------------------------------------------------------------
        ldiu      @CL20,ar0
        ldiu      4000,r0
        sti       r0,*ar0
	.line	16
;----------------------------------------------------------------------
;  64 | TMR1_CTRL = 0x02C2 ;            /* General Out port : TCLK1 */         
;----------------------------------------------------------------------
        ldiu      @CL21,ar0
        ldiu      706,r0
        sti       r0,*ar0
	.line	17
;----------------------------------------------------------------------
;  65 | TMR1_PERD = 7680;               /* 30.72 MHz/4 /(1KHz) = 7680 */       
;----------------------------------------------------------------------
        ldiu      @CL22,ar0
        ldiu      7680,r0
        sti       r0,*ar0
	.line	20
;----------------------------------------------------------------------
;  68 | EDGE_INT;                       /* LEVEL INTERRUPT */                  
;----------------------------------------------------------------------
 OR        04000h, ST 
	.line	22
        ldiu      *-fp(1),ar0
        ldiu      *fp,fp
        subi      3,sp
        bu        ar0
;*      Branch Occurs to ar0 
	.endfunc	70,000000000h,1



	.global	__glDebugData
	.bss	__glDebugData,1
	.sym	__glDebugData,__glDebugData,15,2,32

	.global	__glDebugAddr
	.bss	__glDebugAddr,1
	.sym	__glDebugAddr,__glDebugAddr,15,2,32
;******************************************************************************
;* CONSTANT TABLE                                                             *
;******************************************************************************
	.sect	".const"
	.bss	CL1,1
	.bss	CL2,1
	.bss	CL3,1
	.bss	CL4,1
	.bss	CL5,1
	.bss	CL6,1
	.bss	CL7,1
	.bss	CL8,1
	.bss	CL9,1
	.bss	CL10,1
	.bss	CL11,1
	.bss	CL12,1
	.bss	CL13,1
	.bss	CL14,1
	.bss	CL15,1
	.bss	CL16,1
	.bss	CL17,1
	.bss	CL18,1
	.bss	CL19,1
	.bss	CL20,1
	.bss	CL21,1
	.bss	CL22,1

	.sect	".cinit"
	.field  	22,32
	.field  	CL1+0,32
	.field  	8421452,32
	.field  	305419896,32
	.field  	16777215,32
	.field  	-1,32
	.field  	8421448,32
	.field  	8421442,32
	.field  	8421440,32
	.field  	238813184,32
	.field  	8429510,32
	.field  	1610612736,32
	.field  	_c_int06,32
	.field  	8912390,32
	.field  	65535,32
	.field  	8421476,32
	.field  	984168,32
	.field  	8421480,32
	.field  	984072,32
	.field  	8421472,32
	.field  	8421408,32
	.field  	8421416,32
	.field  	8421424,32
	.field  	8421432,32

	.sect	".text"
